## tests/bluetooth/controller/ctrl_subrating/testcase.yaml
```yaml
common:
  tags:
    - bluetooth
    - bt_subrating
    - bt_ull_llcp
tests:
  bluetooth.controller.ctrl_subrating.test:
    type: unit
```
